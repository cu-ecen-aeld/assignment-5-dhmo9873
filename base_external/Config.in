## base_external/Config.in
```kconfig
menu "Project Base Packages"
source "$BR2_EXTERNAL_PROJECT_BASE_PATH/package/Config.in"
source "$BR2_EXTERNAL_PROJECT_BASE_PATH/package/ldd_assignments/Config.in"
endmenu
```

## base_external/package/ldd/Config.in
```kconfig
config BR2_PACKAGE_LDD_ASSIGNMENTS
    bool "ldd"
    help
      Includes LDD3 scull and misc-modules.
```
